## CMakeLists.txt
```
cmake_minimum_required(VERSION 3.20.0)
find_package(Zephyr REQUIRED HINTS $ENV{ZEPHYR_BASE})
project(devscope_log_demo)

target_sources(app PRIVATE
  src/main.c
  src/sensor.c
  src/ble.c
  src/storage.c
)
```

## prj.conf
```kconfig
# DevScope Log Demo — nRF54L15 DK
# Generates log messages at all severity levels via both RTT and UART

# Logging
CONFIG_LOG=y
CONFIG_LOG_MODE_DEFERRED=y
CONFIG_USE_SEGGER_RTT=y

# Enable BOTH backends for comparison
CONFIG_LOG_BACKEND_RTT=y
CONFIG_LOG_BACKEND_UART=y

# Console over UART (so printk goes to serial terminal)
CONFIG_CONSOLE=y
CONFIG_RTT_CONSOLE=n
CONFIG_UART_CONSOLE=y
CONFIG_SERIAL=y

# RTT buffer configuration
CONFIG_SEGGER_RTT_MAX_NUM_UP_BUFFERS=3
CONFIG_SEGGER_RTT_BUFFER_SIZE_UP=16384
CONFIG_SEGGER_RTT_MODE_NO_BLOCK_SKIP=y

# Log level — INFO for kernel, DEBUG for app modules
CONFIG_LOG_DEFAULT_LEVEL=3
CONFIG_LOG_MAX_LEVEL=4

# Increase Zephyr log buffer to avoid internal drops
CONFIG_LOG_BUFFER_SIZE=8192
```

## src/main.c
```c
/*
 * DevScope Log Demo — nRF54L15 DK
 *
 * Generates log messages from multiple modules at all severity levels.
 * Connect DevScope to RTT (localhost:19021) to see structured output.
 *
 * Build:
 *   cd /Users/mafaneh/Projects/tools/devscope
 *   source samples/nrf54l15-log-demo/setup-env.sh
 *   west build -b nrf54l15dk/nrf54l15/cpuapp samples/nrf54l15-log-demo --build-dir build
 *   west flash --build-dir build
 *
 * DevScope connects to the RTT telnet server at localhost:19021.
 */

#include <zephyr/kernel.h>
#include <zephyr/logging/log.h>
#include "msg_counter.h"

LOG_MODULE_REGISTER(app, LOG_LEVEL_DBG);

/* Subsystem entry points (each in its own file with its own log module) */
void simulate_sensor_activity(void);
void simulate_ble_activity(void);
void simulate_storage_activity(void);

/* Global message sequence counter (defined here, declared in msg_counter.h) */
atomic_t msg_seq = ATOMIC_INIT(0);

int main(void)
{
	SEQ_LOG_INF("DevScope Log Demo started on nRF54L15 DK");
	SEQ_LOG_INF("Both RTT and UART backends active");
	SEQ_LOG_DBG("Log level: DEBUG (all messages visible)");

	int cycle = 0;

	while (1) {
		cycle++;

		/* Main app heartbeat every 10 cycles */
		if (cycle % 10 == 0) {
			SEQ_LOG_INF("Heartbeat: cycle %d, uptime %lld ms",
				cycle, k_uptime_get());
		}

		/* Simulate subsystem activity at different rates */
		simulate_sensor_activity();

		if (cycle % 2 == 0) {
			simulate_ble_activity();
		}

		if (cycle % 3 == 0) {
			simulate_storage_activity();
		}

		k_sleep(K_SECONDS(1));
	}

	return 0;
}
```

## src/ble.c
```c
#include <zephyr/kernel.h>
#include <zephyr/logging/log.h>
#include "msg_counter.h"

LOG_MODULE_REGISTER(ble_conn, LOG_LEVEL_DBG);

static bool connected = false;
static int adv_count = 0;

void simulate_ble_activity(void)
{
	adv_count++;

	if (!connected && adv_count % 5 == 0) {
		connected = true;
		SEQ_LOG_INF("Connected to AA:BB:CC:DD:EE:%02X (interval: %d ms)",
			adv_count % 256, 30 + (adv_count % 20) * 5);
		SEQ_LOG_DBG("MTU exchange: requesting 247 bytes");
		SEQ_LOG_INF("MTU updated to 247");
		SEQ_LOG_DBG("PHY update: requesting 2M PHY");
		SEQ_LOG_INF("PHY updated to 2M");
	} else if (connected && adv_count % 11 == 0) {
		SEQ_LOG_WRN("Connection timeout — supervision expired");
		SEQ_LOG_INF("Disconnected (reason: 0x08)");
		connected = false;
	} else if (connected) {
		SEQ_LOG_DBG("Notification sent: %d bytes", 20 + (adv_count % 200));
	} else {
		SEQ_LOG_DBG("Advertising: interval %d ms", 100 + (adv_count % 50) * 10);
	}
}
```

## src/msg_counter.h
```c
#ifndef MSG_COUNTER_H
#define MSG_COUNTER_H

#include <zephyr/sys/atomic.h>

/* Global message sequence number — incremented before each LOG_* call.
 * Compare the highest seq seen on UART vs RTT to measure dropped messages. */
extern atomic_t msg_seq;

/* Wrapper macros that prepend [seq:N] to every log message */
#define SEQ_LOG_DBG(fmt, ...) LOG_DBG("[seq:%d] " fmt, (int)atomic_inc(&msg_seq), ##__VA_ARGS__)
#define SEQ_LOG_INF(fmt, ...) LOG_INF("[seq:%d] " fmt, (int)atomic_inc(&msg_seq), ##__VA_ARGS__)
#define SEQ_LOG_WRN(fmt, ...) LOG_WRN("[seq:%d] " fmt, (int)atomic_inc(&msg_seq), ##__VA_ARGS__)
#define SEQ_LOG_ERR(fmt, ...) LOG_ERR("[seq:%d] " fmt, (int)atomic_inc(&msg_seq), ##__VA_ARGS__)

#endif
```

## src/sensor.c
```c
#include <zephyr/kernel.h>
#include <zephyr/logging/log.h>
#include "msg_counter.h"

LOG_MODULE_REGISTER(sensor_drv, LOG_LEVEL_DBG);

static int read_count = 0;

void simulate_sensor_activity(void)
{
	read_count++;

	SEQ_LOG_DBG("Starting sensor read cycle %d", read_count);
	SEQ_LOG_INF("Temperature: %d.%02d C", 22 + (read_count % 5),
		(read_count * 17) % 100);
	SEQ_LOG_INF("Humidity: %d%%", 45 + (read_count % 20));

	if (read_count % 7 == 0) {
		SEQ_LOG_WRN("Sensor read took longer than expected: %d ms",
			150 + (read_count * 3) % 200);
	}

	if (read_count % 13 == 0) {
		SEQ_LOG_ERR("Sensor CRC mismatch on read %d (expected 0x%04x, got 0x%04x)",
			read_count, 0xABCD, 0xABCE);
	}
}
```

## src/storage.c
```c
#include <zephyr/kernel.h>
#include <zephyr/logging/log.h>
#include "msg_counter.h"

LOG_MODULE_REGISTER(flash_mgr, LOG_LEVEL_DBG);

static int write_count = 0;

void simulate_storage_activity(void)
{
	write_count++;

	if (write_count % 3 == 0) {
		SEQ_LOG_INF("Flash write: page 0x%05x, %d bytes",
			0x70000 + (write_count * 0x1000) % 0x10000,
			64 + (write_count * 7) % 192);
		SEQ_LOG_DBG("Write complete in %d us", 800 + (write_count * 13) % 400);
	}

	if (write_count % 10 == 0) {
		SEQ_LOG_INF("Flash GC: reclaimed %d bytes from sector %d",
			4096, write_count / 10);
	}

	if (write_count % 25 == 0) {
		SEQ_LOG_WRN("Flash wear level high on sector %d: %d/%d erase cycles",
			write_count / 25, 9500, 10000);
	}
}
```
