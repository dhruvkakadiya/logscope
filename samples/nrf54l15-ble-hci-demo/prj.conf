## CMakeLists.txt
```
cmake_minimum_required(VERSION 3.20.0)
find_package(Zephyr REQUIRED HINTS $ENV{ZEPHYR_BASE})
project(logscope-ble-hci-demo)
target_sources(app PRIVATE
  src/main.c
  src/sensor_drv.c
  src/flash_mgr.c
  src/crypto_mgr.c
  src/ble_mgr.c
)
```

## prj.conf
```kconfig
# LogScope Bluetooth LE HCI Demo — nRF54L15 DK
# Rich logging stress test: multiple modules, all severities, custom GATT service

# Bluetooth LE
CONFIG_BT=y
CONFIG_BT_PERIPHERAL=y
CONFIG_BT_DEVICE_NAME="LogScope Demo"
CONFIG_BT_DIS=y
CONFIG_BT_DIS_MANUF_NAME=y
CONFIG_BT_DIS_MANUF_NAME_STR="Novel Bits"
CONFIG_BT_DIS_MODEL_NUMBER=y
CONFIG_BT_DIS_MODEL_NUMBER_STR="nRF54L15 DK"

# GATT service support
CONFIG_BT_GATT_DYNAMIC_DB=y
CONFIG_BT_ATT_PREPARE_COUNT=5

# Logging over RTT
CONFIG_LOG=y
CONFIG_LOG_MODE_DEFERRED=y
CONFIG_LOG_DEFAULT_LEVEL=3
CONFIG_LOG_MAX_LEVEL=4
CONFIG_LOG_BUFFER_SIZE=8192
CONFIG_USE_SEGGER_RTT=y
CONFIG_LOG_BACKEND_RTT=y
CONFIG_LOG_BACKEND_UART=n
CONFIG_CONSOLE=y
CONFIG_RTT_CONSOLE=y
CONFIG_UART_CONSOLE=n

# RTT buffer config (Channel 0 = console, Channel 1 = btmonitor)
CONFIG_SEGGER_RTT_MAX_NUM_UP_BUFFERS=3
CONFIG_SEGGER_RTT_BUFFER_SIZE_UP=8192
CONFIG_SEGGER_RTT_MODE_NO_BLOCK_SKIP=y

# HCI tracing over RTT Channel 1 (BT Monitor protocol)
CONFIG_BT_DEBUG_MONITOR_RTT=y

# Stack size (needed for burst logging)
CONFIG_MAIN_STACK_SIZE=4096
```

## src/main.c
```c
/*
 * LogScope Bluetooth LE HCI Demo — nRF54L15 DK (Stress Test)
 *
 * Rich logging demo with proper Zephyr log modules:
 * - app (main), sensor_drv, flash_mgr, crypto_mgr, ble_mgr
 * - All severity levels cycling at different intervals
 * - Custom GATT service (read/write/notify)
 * - Burst mode (write 0x01 to command characteristic)
 * - HCI traces on RTT Channel 1
 *
 * Build:
 *   source samples/nrf54l15-ble-hci-demo/setup-env.sh
 *   west build -b nrf54l15dk/nrf54l15/cpuapp samples/nrf54l15-ble-hci-demo --build-dir build-hci -p
 *   west flash --build-dir build-hci
 */

#include <zephyr/kernel.h>
#include <zephyr/logging/log.h>
#include <zephyr/bluetooth/bluetooth.h>
#include <zephyr/bluetooth/hci.h>
#include <zephyr/bluetooth/conn.h>
#include <zephyr/bluetooth/uuid.h>
#include "modules.h"

LOG_MODULE_REGISTER(app, LOG_LEVEL_DBG);

/* Shared burst state (accessed by ble_mgr.c) */
int burst_remaining;

/* Forward declarations from ble_mgr.c */
extern struct bt_conn *ble_mgr_get_conn(void);
extern void ble_mgr_set_conn(struct bt_conn *conn);

/* ── Advertising data ───────────────────────────────────────── */
/* 128-bit UUID as byte array for advertising data */
static const uint8_t logscope_svc_uuid_ad[] = {
	BT_UUID_128_ENCODE(0x12345678, 0x1234, 0x5678, 0x1234, 0x56789abcdef0)
};

static const struct bt_data ad[] = {
	BT_DATA_BYTES(BT_DATA_FLAGS, (BT_LE_AD_GENERAL | BT_LE_AD_NO_BREDR)),
	BT_DATA(BT_DATA_UUID128_ALL, logscope_svc_uuid_ad, sizeof(logscope_svc_uuid_ad)),
};

static const struct bt_data sd[] = {
	BT_DATA(BT_DATA_NAME_COMPLETE, CONFIG_BT_DEVICE_NAME,
		sizeof(CONFIG_BT_DEVICE_NAME) - 1),
};

/* ── Connection callbacks ───────────────────────────────────── */
static void connected(struct bt_conn *conn, uint8_t err)
{
	char addr[BT_ADDR_LE_STR_LEN];

	bt_addr_le_to_str(bt_conn_get_dst(conn), addr, sizeof(addr));

	if (err) {
		LOG_ERR("Connection failed (addr %s, err 0x%02x %s)",
			addr, err, bt_hci_err_to_str(err));
		return;
	}

	LOG_INF("Connected: %s", addr);
	ble_mgr_set_conn(conn);
	ble_mgr_on_connected();
}

static void disconnected(struct bt_conn *conn, uint8_t reason)
{
	char addr[BT_ADDR_LE_STR_LEN];

	bt_addr_le_to_str(bt_conn_get_dst(conn), addr, sizeof(addr));
	LOG_INF("Disconnected: %s (reason 0x%02x %s)",
		addr, reason, bt_hci_err_to_str(reason));

	ble_mgr_set_conn(NULL);
	ble_mgr_on_disconnected();

	int ret = bt_le_adv_start(BT_LE_ADV_CONN_FAST_1, ad, ARRAY_SIZE(ad),
				  sd, ARRAY_SIZE(sd));
	if (ret) {
		LOG_ERR("Re-advertising failed (err %d)", ret);
	} else {
		LOG_INF("Re-advertising started");
	}
}

static void le_param_updated(struct bt_conn *conn, uint16_t interval,
			     uint16_t latency, uint16_t timeout)
{
	LOG_INF("Connection params updated: interval %d (%.2f ms), latency %d, timeout %d",
		interval, interval * 1.25, latency, timeout);
}

BT_CONN_CB_DEFINE(conn_callbacks) = {
	.connected = connected,
	.disconnected = disconnected,
	.le_param_updated = le_param_updated,
};

/* ── Burst mode ─────────────────────────────────────────────── */
void burst_run(int *remaining)
{
	static const char *labels[] = {"sensor", "ble", "flash", "crypto", "app"};
	int idx = *remaining % 5;

	switch (*remaining % 4) {
	case 0:
		LOG_ERR("BURST #%d [%s]: Simulated critical error (code 0x%02x)",
			50 - *remaining, labels[idx], *remaining);
		break;
	case 1:
		LOG_WRN("BURST #%d [%s]: Simulated warning condition",
			50 - *remaining, labels[idx]);
		break;
	case 2:
		LOG_INF("BURST #%d [%s]: Simulated state change event",
			50 - *remaining, labels[idx]);
		break;
	case 3:
		LOG_DBG("BURST #%d [%s]: Simulated verbose trace data (0x%08x)",
			50 - *remaining, labels[idx], *remaining * 0xABCD);
		break;
	}

	(*remaining)--;
	if (*remaining == 0) {
		LOG_INF("Burst mode complete (50 messages sent)");
	}
}

/* ── Main ───────────────────────────────────────────────────── */
int main(void)
{
	int err;

	LOG_INF("LogScope Bluetooth LE HCI Demo starting (stress test)");
	LOG_INF("HCI traces streaming to RTT Channel 1");

	/* Initialize modules */
	sensor_drv_init();
	flash_mgr_init();
	crypto_mgr_init();

	err = bt_enable(NULL);
	if (err) {
		LOG_ERR("Bluetooth init failed (err %d)", err);
		return 0;
	}

	LOG_INF("Bluetooth initialized");

	err = bt_le_adv_start(BT_LE_ADV_CONN_FAST_1, ad, ARRAY_SIZE(ad),
			      sd, ARRAY_SIZE(sd));
	if (err) {
		LOG_ERR("Advertising failed to start (err %d)", err);
		return 0;
	}

	LOG_INF("Advertising as \"%s\"", CONFIG_BT_DEVICE_NAME);
	ble_mgr_init();

	int cycle = 0;

	while (1) {
		cycle++;

		/* Burst mode: rapid-fire logging */
		if (burst_remaining > 0) {
			burst_run(&burst_remaining);
			k_sleep(K_MSEC(20));
			continue;
		}

		/* Sensor readings every 2 seconds */
		if (cycle % 2 == 0) {
			sensor_drv_read(cycle);
			ble_mgr_send_notification(sensor_drv_get_value());
		}

		/* Flash activity */
		flash_mgr_tick(cycle);

		/* Crypto activity */
		crypto_mgr_tick(cycle);

		/* Bluetooth LE manager activity */
		ble_mgr_tick(cycle);

		/* Heartbeat every 5 seconds */
		if (cycle % 5 == 0) {
			if (ble_mgr_get_conn()) {
				LOG_INF("Heartbeat %d: connected, uptime %lld ms",
					cycle, k_uptime_get());
			} else {
				LOG_INF("Heartbeat %d: advertising, uptime %lld ms",
					cycle, k_uptime_get());
			}
		}

		k_sleep(K_SECONDS(1));
	}

	return 0;
}
```

## src/ble_mgr.c
```c
/*
 * Bluetooth LE manager — GATT service, notifications, connection management
 * Registers as its own Zephyr log module for proper filtering in LogScope.
 */

#include <zephyr/kernel.h>
#include <zephyr/logging/log.h>
#include <zephyr/bluetooth/bluetooth.h>
#include <zephyr/bluetooth/conn.h>
#include <zephyr/bluetooth/uuid.h>
#include <zephyr/bluetooth/gatt.h>
#include <zephyr/sys/byteorder.h>
#include "modules.h"

LOG_MODULE_REGISTER(ble_mgr, LOG_LEVEL_DBG);

/* ── Custom GATT Service UUIDs ──────────────────────────────── */

static struct bt_uuid_128 logscope_svc_uuid = BT_UUID_INIT_128(
	BT_UUID_128_ENCODE(0x12345678, 0x1234, 0x5678, 0x1234, 0x56789abcdef0));

static struct bt_uuid_128 info_char_uuid = BT_UUID_INIT_128(
	BT_UUID_128_ENCODE(0x12345678, 0x1234, 0x5678, 0x1234, 0x56789abcdef1));

static struct bt_uuid_128 cmd_char_uuid = BT_UUID_INIT_128(
	BT_UUID_128_ENCODE(0x12345678, 0x1234, 0x5678, 0x1234, 0x56789abcdef2));

static struct bt_uuid_128 sensor_char_uuid = BT_UUID_INIT_128(
	BT_UUID_128_ENCODE(0x12345678, 0x1234, 0x5678, 0x1234, 0x56789abcdef3));

/* ── State ──────────────────────────────────────────────────── */
static struct bt_conn *current_conn;
static bool notify_enabled;
extern int burst_remaining;  /* defined in main.c */

/* ── GATT: Read characteristic (device info) ────────────────── */
static ssize_t read_info(struct bt_conn *conn, const struct bt_gatt_attr *attr,
			 void *buf, uint16_t len, uint16_t offset)
{
	const char *info = "LogScope Demo v2 | nRF54L15 DK | Novel Bits";

	LOG_DBG("GATT read: info characteristic");
	return bt_gatt_attr_read(conn, attr, buf, len, offset, info, strlen(info));
}

/* ── GATT: Write characteristic (command) ───────────────────── */
static ssize_t write_cmd(struct bt_conn *conn, const struct bt_gatt_attr *attr,
			 const void *buf, uint16_t len, uint16_t offset, uint8_t flags)
{
	if (len < 1) {
		return BT_GATT_ERR(BT_ATT_ERR_INVALID_ATTRIBUTE_LEN);
	}

	uint8_t cmd = ((const uint8_t *)buf)[0];

	switch (cmd) {
	case 0x01:
		LOG_WRN("Burst mode triggered via GATT write (50 messages)");
		burst_remaining = 50;
		break;
	case 0x02:
		LOG_INF("Reset sensor counter via GATT write");
		break;
	case 0x03:
		LOG_INF("Manual flash erase triggered via GATT");
		break;
	default:
		LOG_WRN("Unknown command byte: 0x%02x", cmd);
		break;
	}

	return len;
}

/* ── GATT: Notify characteristic (sensor data) ──────────────── */
static void sensor_ccc_changed(const struct bt_gatt_attr *attr, uint16_t value)
{
	notify_enabled = (value == BT_GATT_CCC_NOTIFY);
	LOG_INF("Sensor notifications %s", notify_enabled ? "enabled" : "disabled");
}

/* ── GATT Service Registration ──────────────────────────────── */
BT_GATT_SERVICE_DEFINE(logscope_svc,
	BT_GATT_PRIMARY_SERVICE(&logscope_svc_uuid),
	BT_GATT_CHARACTERISTIC(&info_char_uuid.uuid,
		BT_GATT_CHRC_READ, BT_GATT_PERM_READ,
		read_info, NULL, NULL),
	BT_GATT_CHARACTERISTIC(&cmd_char_uuid.uuid,
		BT_GATT_CHRC_WRITE, BT_GATT_PERM_WRITE,
		NULL, write_cmd, NULL),
	BT_GATT_CHARACTERISTIC(&sensor_char_uuid.uuid,
		BT_GATT_CHRC_NOTIFY, BT_GATT_PERM_NONE,
		NULL, NULL, NULL),
	BT_GATT_CCC(sensor_ccc_changed, BT_GATT_PERM_READ | BT_GATT_PERM_WRITE),
);

/* ── Public API ─────────────────────────────────────────────── */

void ble_mgr_init(void)
{
	LOG_INF("GATT service registered: read + write + notify characteristics");
}

void ble_mgr_on_connected(void)
{
	notify_enabled = false;
}

void ble_mgr_on_disconnected(void)
{
	notify_enabled = false;
}

struct bt_conn *ble_mgr_get_conn(void)
{
	return current_conn;
}

void ble_mgr_set_conn(struct bt_conn *conn)
{
	if (current_conn) {
		bt_conn_unref(current_conn);
	}
	current_conn = conn ? bt_conn_ref(conn) : NULL;
}

void ble_mgr_send_notification(uint32_t value)
{
	if (!current_conn || !notify_enabled) {
		return;
	}

	uint8_t data[4];
	sys_put_le32(value, data);

	int err = bt_gatt_notify(current_conn, &logscope_svc.attrs[7], data, sizeof(data));
	if (err) {
		LOG_WRN("Sensor notification failed (err %d)", err);
	} else {
		LOG_DBG("Sensor notification sent: value=%u", value);
	}
}

void ble_mgr_tick(int cycle)
{
	if (cycle % 10 == 0 && current_conn) {
		LOG_DBG("RSSI check scheduled for connection 0x0040");
	}
	if (cycle % 20 == 0) {
		LOG_INF("Advertising data updated (TX power: %d dBm)", -4 + (cycle % 3));
	}
}
```

## src/modules.h
```c
/*
 * LogScope Demo — shared declarations for simulated modules
 */

#ifndef LOGSCOPE_DEMO_MODULES_H
#define LOGSCOPE_DEMO_MODULES_H

#include <stdint.h>
#include <stdbool.h>

/* Sensor driver */
void sensor_drv_init(void);
void sensor_drv_read(int cycle);
uint32_t sensor_drv_get_value(void);

/* Flash manager */
void flash_mgr_init(void);
void flash_mgr_tick(int cycle);

/* Crypto manager */
void crypto_mgr_init(void);
void crypto_mgr_tick(int cycle);

/* Bluetooth LE manager */
void ble_mgr_init(void);
void ble_mgr_tick(int cycle);
void ble_mgr_on_connected(void);
void ble_mgr_on_disconnected(void);
void ble_mgr_send_notification(uint32_t value);
struct bt_conn *ble_mgr_get_conn(void);
void ble_mgr_set_conn(struct bt_conn *conn);

/* Burst mode */
void burst_run(int *remaining);

#endif
```
